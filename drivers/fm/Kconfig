## drivers/misc/awinic/sarsensor/Kconfig
```kconfig
config AWINIC_SAR
	tristate "Awinic SAR sensor support"
	depends on I2C && SENSORS_CLASS
	default m
```

## drivers/misc/ldo_vibrator_mmi/Kconfig
```kconfig
# SPDX-License-Identifier: GPL-2.0-only
config LDO_VIBRATOR_MMI
	bool "Motorola GPIO LDO vibrator"
	depends on OF && GPIOLIB && LEDS_CLASS
	help
	  Build the Motorola moto,vibrator-ldo GPIO vibrator driver.
```

## drivers/misc/mmi_sys_temp/Kconfig
```kconfig
config MMI_SYS_TEMP
	tristate "Motorola MMI System Temperature driver"
	default m
	help
	  Say M here if you want to support Motorola MMI system temperature monitoring.
```

## drivers/misc/sx937x/Kconfig
```kconfig
config SX937X_SAR
    tristate "Semtech SX937X SAR sensor driver"
    depends on I2C
    help
      Say Y or M here if you want to support Semtech SX937X proximity/SAR sensor.
```

## drivers/misc/utag/Kconfig
```kconfig
config UTAG
	tristate "Motorola Utag/Utags driver"
	default m
	help
	  Say M here if you want to support Motorola utags partition driver.
```

## drivers/mmi_annotate/Kconfig
```kconfig
config MMI_ANNOTATE
	tristate "Motorola MMI ANNOTATE driver"
	default m
	help
	  Say M here if you want to build this module.
```

## drivers/mmi_info/Kconfig
```kconfig
config MMI_INFO
	tristate "Motorola MMI Info driver"
	depends on MMI_ANNOTATE
	default m
	help
	  Say Y or M here if you want to support Motorola MMI info driver.
```

## drivers/mmi_relay/Kconfig
```kconfig
config MMI_RELAY
	tristate "Motorola MMI RELAY driver"
	default m
	help
	  Say M here if you want to build this module.
```

## drivers/moto_f_usbnet/Kconfig
```kconfig
config MOTO_F_USBNET
	tristate "Motorola MOTO F USBNET driver"
	default m
	help
	  Say M here if you want to build this module.
```

## drivers/power/bq25980_mmi_iio/Kconfig
```kconfig
config BQ25980_MMI_IIO
	tristate "BQ25980 MMI IIO charger driver"
	default m

config MMI_BQ25980_BULK_READ
	bool "MMI BQ25980 bulk reads"
	depends on BQ25980_MMI_IIO
```

## drivers/power/mmi-smbcharger-iio/Kconfig
```kconfig
config MMI_SMBCHARGER_IIO
	tristate "Motorola MMI SMBCharger IIO driver"
	default m
```

## drivers/power/mmi_parallel_charger_iio/Kconfig
```kconfig
config MMI_PARALLEL_CHARGER_IIO
	tristate "Motorola MMI Parallel Charger IIO driver"
	default m
	help
	  Say M here if you want to support Motorola parallel charger IIO interface.
```

## drivers/sensors/Kconfig
```kconfig
config SENSORS_CLASS
	tristate "Sensors class driver"
	default m
	help
	  Say M here if you want to support the sensors class framework.
```

## techpack/audio/asoc/codecs/aw882xx/Kconfig
```kconfig
# SPDX-License-Identifier: GPL-2.0-only
config SND_SOC_AW882XX_K419
	bool "AW882XX legacy amplifier"
	depends on I2C
	help
	  Build the legacy AW882XX SmartPA driver.

config SND_SOC_AW882XX_ACF
	bool "AW882XX ACF amplifier"
	depends on I2C
	help
	  Build the AW882XX ACF SmartPA driver.
```

## techpack/datarmnet-ext/Kconfig
```kconfig
# SPDX-License-Identifier: GPL-2.0-only
config RMNET_OFFLOAD
	bool "RMNET offload"
	depends on RMNET_CORE
	help
	  Build RMNET receive offload support.

config RMNET_SHS
	bool "RMNET SHS"
	depends on RMNET_CORE
	help
	  Build RMNET smart hash scheduling support.
```

## techpack/datarmnet/Kconfig
```kconfig
# SPDX-License-Identifier: GPL-2.0-only
config RMNET_CORE
	bool "Qualcomm RMNET core"
	depends on NET && INET
	default y if ARCH_HOLI
	help
	  Build the Qualcomm RMNET data and control drivers.
```
