## drivers/input/touchscreen/chipone_tddi_v2_mmi/Kconfig
```kconfig
config TOUCHSCREEN_CHIPONE_V2_MMI
	tristate "CHIPONE TDDI V2 Touchscreen"
	default n
	help
	  Say Y here if you have a Chipone flash touchscreen connected
	  to your system by SPI bus.

	  If unsure, say N.

config TOUCHSCREEN_CHIPONE_V2_MMI_ESD
	bool "ESD Detection"
	depends on TOUCHSCREEN_CHIPONE_V2_MMI
	default n
	help
	  Say Y here if you want to have ESD Detection support.

	  If unsure, say N.
	  
config INPUT_CHIPONE_V2_MMI_0FLASH_MMI_ENABLE_DOUBLE_TAP
	bool "Enable Double Tap"
	depends on TOUCHSCREEN_CHIPONE_V2_MMI
	default n
	help
	  Say Y here if you want to have ESD Detection support.

	  If unsure, say N.

config INPUT_CHIPONE_V2_MMI_0FLASH_MMI_NOTIFY_TOUCH_STATE
	bool "Notify Touch State"
	depends on TOUCHSCREEN_CHIPONE_V2_MMI
	default n
	help
	  Say Y here if you want to have ESD Detection support.

	  If unsure, say N.

config INPUT_CHIPONE_V2_MMI_PANEL_NOTIFICATIONS
	bool "Panel Notifications"
	depends on TOUCHSCREEN_CHIPONE_V2_MMI
	default n
	help
	  Say Y here if you want to have ESD Detection support.

	  If unsure, say N.

config GTP_LAST_TIME
	bool "GTP Last Time"
	depends on TOUCHSCREEN_CHIPONE_V2_MMI
	default n
	help
	  Say Y here if you want to have ESD Detection support.

	  If unsure, say N.

config INPUT_CHIPONE_BOARD_USES_DOUBLE_TAP_CTRL
	bool "Double Tap Control"
	depends on TOUCHSCREEN_CHIPONE_V2_MMI
	default n
	help
	  Say Y here if you want to have ESD Detection support.

	  If unsure, say N.

config INPUT_TOUCHSCREEN_MMI
	bool "Moto touchscreen mmi"
	depends on TOUCHSCREEN_CHIPONE_V2_MMI
	default n
	help
	  Say Y here if you want to have ESD Detection support.

	  If unsure, say N.

config INPUT_CHIPONE_STOWED_MODE_EN
	bool "Enable Stowed mode"
	depends on TOUCHSCREEN_CHIPONE_V2_MMI
	default n
	help
	  Say Y here if you want to have ESD Detection support.

	  If unsure, say N.

config TOUCHSCREEN_PM_BRL_SPI
	bool "SPI interface for touchscreen"
	depends on TOUCHSCREEN_CHIPONE_V2_MMI
	default n
	help
	  Say Y here if you want to have ESD Detection support.

	  If unsure, say N.

config CHIPONE_V2_MMI_CHECK_DEVICE_BOOTMODE
	bool "Check Device Boot Mode"
	depends on TOUCHSCREEN_CHIPONE_V2_MMI
	default n
	help
	  Say Y here if you want to have ESD Detection support.

	  If unsure, say N.
```

## drivers/input/touchscreen/focaltech_touch_v3/Kconfig
```kconfig
#
# Focaltech Touchscreen driver configuration
#

config TOUCHSCREEN_FTS_V3
	tristate "Focaltech Touchscreen V3"
	default n
	help
	  Say Y here if you have Focaltech V3 touch panel.
	  If unsure, say N.

config TOUCHSCREEN_FTS_V3_ENABLE_DOUBLE_TAP
	bool "Enable double tap"
	depends on TOUCHSCREEN_FTS_V3
	default n
	help
	  Say Y here to enable double tap functionality on Focaltech V3 touch panel.
	  If unsure, say N.

config TOUCHSCREEN_FTS_V3_ENABLE_PALM
	bool "Enable palm sensing"
	depends on TOUCHSCREEN_FTS_V3
	default n
	help
	  Say Y here to enable palm sensing functionality on Focaltech V3 touch panel.
	  If unsure, say N.

config FTS_NOISE_TEST_P2P
	bool "Enable P2P noise test"
	depends on TOUCHSCREEN_FTS_V3
	default n
	help
	  Say Y here to enable P2P noise test functionality on Focaltech V3 touch panel.
	  If unsure, say N.

config FTS_COMPATIBLE_WITH_GKI
	bool "Enable GKI compatibility"
	depends on TOUCHSCREEN_FTS_V3
	default n
	help
	  Say Y here to enable GKI compatibility on Focaltech V3 touch panel.
	  If unsure, say N.

config FTS_DOUBLE_TAP_CONTROL
	bool "Enable double tap control"
	depends on TOUCHSCREEN_FTS_V3
	default n
	help
	  Say Y here to enable double tap control functionality on Focaltech V3 touch panel.
	  If unsure, say N.

config FTS_SUPPORT_HIGH_RESOLUTION
	bool "Enable high resolution"
	depends on TOUCHSCREEN_FTS_V3
	default n
	help
	  Say Y here to enable high resolution functionality on Focaltech V3 touch panel.
	  If unsure, say N.

config FTS_VDD_GPIO_CONTROL
	bool "Enable VDD GPIO control"
	depends on TOUCHSCREEN_FTS_V3
	default n
	help
	  Say Y here to enable VDD GPIO control functionality on Focaltech V3 touch panel.
	  If unsure, say N.

config FTS_LAST_TIME
	bool "Enable last time"
	depends on TOUCHSCREEN_FTS_V3
	default n
	help
	  Say Y here to enable last time functionality on Focaltech V3 touch panel.
	  If unsure, say N.

config FTS_INPUT_ID
	bool "Enable input ID"
	depends on TOUCHSCREEN_FTS_V3
	default n
	help
	  Say Y here to enable input ID functionality on Focaltech V3 touch panel.
	  If unsure, say N.
```

## drivers/input/touchscreen/ilitek_v3_mmi/Kconfig
```kconfig
config TOUCHSCREEN_ILITEK_CHIPSET
	tristate "ILITEK Touchscreen"
	default n
	help
	  Say Y here if you have a Chipone flash touchscreen connected
	  to your system by SPI bus.

	  If unsure, say N.
	  
config TOUCHSCREEN_ILITEK_ESD
	bool "ESD Checking"
	default n
	help
	  Say Y here if you have a Chipone flash touchscreen connected
	  to your system by SPI bus.

	  If unsure, say N.
	  
config INPUT_ILI_ENABLE_DOUBLE_TAP
	bool "Enable Double Tap"
	default n
	help
	  Say Y here if you have a Chipone flash touchscreen connected
	  to your system by SPI bus.

	  If unsure, say N.

config INPUT_ILI_BOARD_USES_DOUBLE_TAP_CTRL
	bool "Double Tap Control"
	default n
	help
	  Say Y here if you have a Chipone flash touchscreen connected
	  to your system by SPI bus.

	  If unsure, say N.

config INPUT_ILI_SET_TOUCH_STATE
	bool "Set Touch state"
	default n
	help
	  Say Y here if you have a Chipone flash touchscreen connected
	  to your system by SPI bus.

	  If unsure, say N.

config INPUT_ILI_PANEL_NOTIFICATIONS
	bool "Panel notifications"
	default n
	help
	  Say Y here if you have a Chipone flash touchscreen connected
	  to your system by SPI bus.

	  If unsure, say N.

config ILITEK_RESUME_BY_DDI
	bool "Resume by DDI"
	default n
	help
	  Say Y here if you have a Chipone flash touchscreen connected
	  to your system by SPI bus.

	  If unsure, say N.

config ILITEK_CHARGER
	bool "ILITEK charger"
	default n
	help
	  Say Y here if you have a Chipone flash touchscreen connected
	  to your system by SPI bus.

	  If unsure, say N.

config ILITEK_MTK_CHECK_PANEL
	bool "Check panel"
	default n
	help
	  Say Y here if you have a Chipone flash touchscreen connected
	  to your system by SPI bus.

	  If unsure, say N.

config ILITEK_MULTI_TP_MODULE
	bool "Multi TP module"
	default n
	help
	  Say Y here if you have a Chipone flash touchscreen connected
	  to your system by SPI bus.

	  If unsure, say N.

config ILI_TOUCH_LAST_TIME
	bool "Touch last time"
	default n
	help
	  Say Y here if you have a Chipone flash touchscreen connected
	  to your system by SPI bus.

	  If unsure, say N.

config INPUT_TOUCHSCREEN_MMI
	bool "Moto touchscreen mmi"
	default n
	help
	  Say Y here if you have a Chipone flash touchscreen connected
	  to your system by SPI bus.

	  If unsure, say N.

config INPUT_ILI_STOWED_MODE_EN
	bool "Enable Stowed mode"
	depends on TOUCHSCREEN_CHIPONE_V2_MMI
	default n
	help
	  Say Y here if you want to have ESD Detection support.

	  If unsure, say N.
```

## drivers/moto_mm/Kconfig
```kconfig
# SPDX-License-Identifier: GPL-2.0
config MOTO_MM
        tristate "Moto MM"
        default n
        help
         Say Y here if you have a MOTO MM compatible
         device defined.

         This driver can also be built as a module.  If so, the module
         will be called f_usbnet.
```

## drivers/moto_swap/Kconfig
```kconfig
# SPDX-License-Identifier: GPL-2.0
config MOTO_SWAP
	tristate "Moto SWAP"
	default n
	help
	Say Y here if you have a MOTO SWAP compatible
	device defined.

	This driver can also be built as a module.  If so, the module
	will be called f_usbnet.  
```

## fs/susfs/Kconfig
```kconfig
# SPDX-License-Identifier: GPL-2.0-only

config SUS_FS
	bool "SUSFS_KSU"
	default y
	depends on KSU
```
